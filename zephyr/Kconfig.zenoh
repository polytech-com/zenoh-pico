## zephyr/Kconfig.zenoh
```kconfig
config ZENOH_PICO
	bool "Zenoh PICO library"
	help
	  Enable Zenoh pico support

if ZENOH_PICO

config ZENOH_PICO_LINK_SERIAL
	bool "Serial Link"
	help
	  Use serial link

config ZENOH_PICO_MULTI_THREAD
	bool "Multithreading support"
	help
	  Multithreading support

config ZENOH_PICO_PUBLICATION
	bool "Publication Support"
	help
	  Publication support

config ZENOH_PICO_SUBSCRIPTION
	bool "Subscription Support"
	help
	  Subscription Support

config ZENOH_PICO_QUERY
	bool "Query Support"
	help
	  Query Support

config ZENOH_PICO_QUERYABLE
	bool "Queryable Support"
	help
	  Queryable Support

config ZENOH_PICO_RAWETH_TRANSPORT
	bool "Raw Ethernet Support"
	help
	  Raw Ethernet Support

config ZENOH_PICO_LINK_TCP
	bool "TCP Link"
	help
	  TCP Link

config ZENOH_PICO_LINK_UDP_UNICAST
	bool "UDP Unicast"
	help
	  UDP Unicast

config ZENOH_PICO_LINK_UDP_MULTICAST
	bool "UDP Multicast"
	help
	  UDP Multicast

config ZENOH_PICO_SCOUTING
	bool "Scouting UDP"
	help
	  Scouting UDP

config ZENOH_PICO_LINK_WS
	bool "WS Link"
	help
	  WS Link

config ZENOH_PICO_THREADS_NUM
	int "Number of preallocated pthread stacks"
	depends on ZENOH_PICO_MULTI_THREAD
	default 4
	help
	  Number of preallocated pthread stacks used when no explicit thread
	  attributes are provided (attr == NULL). Stack slots are returned to the
	  pool when threads are joined.

config ZENOH_PICO_STACK_SIZE
	int "Zenoh thread stack size"
	default MAIN_STACK_SIZE
	help
	  Stack size for zenoh-pico's preallocated pthread stacks, sized
	  independently of MAIN_STACK_SIZE.

config ZENOH_PICO_TCP_SEND_TIMEOUT
	bool "Bound how long a zenoh TCP send() may block"
	select NET_CONTEXT_SNDTIMEO if NETWORKING
	help
	  Applies SO_SNDTIMEO to zenoh TCP link sockets so a send() cannot block forever.

	  Off by default: leaving sockets blocking is upstream behaviour, so enabling this
	  is an explicit application decision. Enable it if a thread that can reach zenoh's
	  send() path is under a watchdog, since a peer that stops draining its receive
	  window will otherwise wedge that thread while it holds the transport TX mutex.

	  This exists as a separate symbol purely so it can select NET_CONTEXT_SNDTIMEO:
	  Kconfig cannot select from an int symbol. Disabling it leaves sockets blocking,
	  which is upstream behaviour but allows a stalled peer to wedge the sending
	  thread while it holds the transport TX mutex.

config ZENOH_PICO_TCP_SEND_TIMEOUT_MS
	int "TCP send timeout (ms)"
	depends on ZENOH_PICO_TCP_SEND_TIMEOUT
	default 500
	help
	  SO_SNDTIMEO applied to zenoh TCP link sockets. Without it, send() on a
	  blocking socket can stall indefinitely when the peer stops draining its
	  receive window (a router that vanishes without a TCP RST), wedging the
	  caller while it holds the transport TX mutex.

	  A timed-out send is reported as a short write, which _z_link_send_wbuf()
	  treats as _Z_ERR_TRANSPORT_TX_FAILED, tearing the link down for
	  reconnection rather than continuing on a desynced stream.

	  Keep this below the tightest thread watchdog that can reach zenoh's
	  send() path.

	  Selects NET_CONTEXT_SNDTIMEO, which Zephyr requires before it will honour
	  SO_SNDTIMEO at all. A build with a non-zero timeout but without that option
	  is rejected by a BUILD_ASSERT, and a socket that rejects the option at
	  runtime fails to open, so the timeout can never be silently absent.

	  Set ZENOH_PICO_TCP_SEND_TIMEOUT=n to leave the socket blocking (upstream behaviour).

endif
```
